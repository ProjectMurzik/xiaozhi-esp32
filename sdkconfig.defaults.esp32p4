## sdkconfig.defaults.esp32p4
```kconfig
# ============================================
# Platform Target
# ============================================
CONFIG_IDF_TARGET="esp32p4"
CONFIG_IDF_EXPERIMENTAL_FEATURES=y

# ============================================
# Compiler Optimization
# ============================================
# Для P4 лучше производительность
CONFIG_COMPILER_OPTIMIZATION_PERF=y
# CONFIG_COMPILER_OPTIMIZATION_SIZE=y  # Закомментировать
CONFIG_COMPILER_CXX_EXCEPTIONS=y
CONFIG_COMPILER_CXX_EXCEPTIONS_EMG_POOL_SIZE=1024
CONFIG_COMPILER_CXX_RTTI=y

# ============================================
# Bootloader
# ============================================
CONFIG_BOOTLOADER_COMPILER_OPTIMIZATION_PERF=y
CONFIG_BOOTLOADER_LOG_LEVEL_NONE=y
CONFIG_BOOTLOADER_SKIP_VALIDATE_ALWAYS=y
CONFIG_BOOTLOADER_APP_ROLLBACK_ENABLE=y

# ============================================
# Flash & Partition
# ============================================
CONFIG_ESPTOOLPY_FLASHSIZE_16MB=y
CONFIG_ESPTOOLPY_FLASHMODE_DIO=y
CONFIG_ESPTOOLPY_FLASHFREQ_80M=y
CONFIG_PARTITION_TABLE_CUSTOM=y
CONFIG_PARTITION_TABLE_CUSTOM_FILENAME="partitions/v2/16m.csv"
CONFIG_PARTITION_TABLE_OFFSET=0x8000

# ============================================
# PSRAM (32MB on your board)
# ============================================
CONFIG_SPIRAM=y
CONFIG_SPIRAM_MODE_QUAD=y
CONFIG_SPIRAM_TYPE_AUTO=y
CONFIG_SPIRAM_SPEED_200M=y
CONFIG_SPIRAM_XIP_FROM_PSRAM=y
CONFIG_SPIRAM_FETCH_INSTRUCTIONS=y
CONFIG_SPIRAM_RODATA=y
CONFIG_SPIRAM_MALLOC_ALWAYSINTERNAL=4096
CONFIG_SPIRAM_MALLOC_RESERVE_INTERNAL=65536
CONFIG_SPIRAM_TRY_ALLOCATE_WIFI_LWIP=y
CONFIG_MBEDTLS_EXTERNAL_MEM_ALLOC=y

# ============================================
# Wi-Fi via ESP32-C6 (CRITICAL!)
# ============================================
CONFIG_SLAVE_IDF_TARGET_ESP32C6=y
CONFIG_ESP_WIFI_REMOTE_ENABLED=y
CONFIG_ESP_HOSTED_ENABLED=y
CONFIG_ESP_WIFI_REMOTE_CONTROL_RX_BUFFER_NUM=10
CONFIG_ESP_WIFI_REMOTE_CONTROL_TX_BUFFER_NUM=10

# ============================================
# Wi-Fi Memory Optimization
# ============================================
CONFIG_ESP_WIFI_IRAM_OPT=n
CONFIG_ESP_WIFI_RX_IRAM_OPT=n
CONFIG_ESP_WIFI_DYNAMIC_RX_MGMT_BUFFER=y
CONFIG_ESP_WIFI_STATIC_RX_BUFFER_NUM=6
CONFIG_ESP_WIFI_DYNAMIC_RX_BUFFER_NUM=8
CONFIG_ESP_WIFI_ENTERPRISE_SUPPORT=n

# ============================================
# Audio Codec ES8311
# ============================================
CONFIG_ESP_CODEC_ES8311_ENABLED=y
CONFIG_ESP_CODEC_DEV_ENABLED=y
CONFIG_CODEC_I2C_BACKWARD_COMPATIBLE=n

# ============================================
# System Tasks
# ============================================
CONFIG_ESP_TASK_WDT_TIMEOUT_S=10
CONFIG_ESP_MAIN_TASK_STACK_SIZE=10240  # Увеличил для P4
CONFIG_AUDIO_TASK_STACK_SIZE=8192
CONFIG_FREERTOS_HZ=1000
CONFIG_FREERTOS_GENERATE_RUN_TIME_STATS=y
CONFIG_FREERTOS_USE_STATS_FORMATTING_FUNCTIONS=y
CONFIG_FREERTOS_VTASKLIST_INCLUDE_COREID=y

# ============================================
# HTTP Server
# ============================================
CONFIG_HTTPD_MAX_REQ_HDR_LEN=2048
CONFIG_HTTPD_MAX_URI_LEN=2048

# ============================================
# SSL/TLS
# ============================================
CONFIG_MBEDTLS_DYNAMIC_BUFFER=y
CONFIG_MBEDTLS_SSL_KEEP_PEER_CERTIFICATE=n
CONFIG_MBEDTLS_SSL_RENEGOTIATION=n

# ============================================
# UART
# ============================================
CONFIG_UART_ISR_IN_IRAM=y

# ============================================
# LVGL Configuration
# ============================================
CONFIG_LV_OS_NONE=y
CONFIG_LV_USE_CLIB_MALLOC=y
CONFIG_LV_USE_CLIB_STRING=y
CONFIG_LV_USE_CLIB_SPRINTF=y
CONFIG_LV_USE_IMGFONT=y
CONFIG_LV_USE_ASSERT_STYLE=y
CONFIG_LV_FONT_FMT_TXT_LARGE=y
CONFIG_LV_USE_FONT_COMPRESSED=n
CONFIG_LV_USE_FONT_PLACEHOLDER=n
CONFIG_LV_USE_LODEPNG=y
CONFIG_LV_USE_SNAPSHOT=y
CONFIG_LV_COLOR_DEPTH_16=y
CONFIG_LV_COLOR_16_SWAP=y
CONFIG_LVGL_TICKLESS=y

# Disable extra widgets to save flash
CONFIG_LV_USE_ANIMIMG=n
CONFIG_LV_USE_CALENDAR=n
CONFIG_LV_USE_CALENDAR_HEADER_ARROW=n
CONFIG_LV_USE_CALENDAR_HEADER_DROPDOWN=n
CONFIG_LV_USE_CHART=n
CONFIG_LV_USE_KEYBOARD=n
CONFIG_LV_USE_LED=n
CONFIG_LV_USE_LIST=n
CONFIG_LV_USE_MENU=n
CONFIG_LV_USE_MSGBOX=n
CONFIG_LV_USE_SPAN=n
CONFIG_LV_USE_SPINBOX=n
CONFIG_LV_USE_SPINNER=n
CONFIG_LV_USE_TABVIEW=n
CONFIG_LV_USE_TILEVIEW=n
CONFIG_LV_USE_WIN=n

CONFIG_LV_BUILD_EXAMPLES=n
CONFIG_LV_BUILD_DEMOS=n

# ============================================
# Voice Wakeup
# ============================================
CONFIG_SR_WN_WN9_NIHAOXIAOZHI_TTS=y

# ============================================
# Video/Camera (optional)
# ============================================
CONFIG_ESP_VIDEO_ENABLE_ISP_PIPELINE_CONTROLLER=y
CONFIG_USB_HOST_CONTROL_TRANSFER_MAX_SIZE=1024

# ============================================
# C Library
# ============================================
CONFIG_NEWLIB_NANO_FORMAT=y
```
